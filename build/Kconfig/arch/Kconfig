## build/Kconfig/arch/Kconfig
```kconfig
# Load arch Kconfig descriptions.
osource "/Users/juliafaubus/zephyr-project/zephyr/arch/x86/Kconfig"
osource "/Users/juliafaubus/zephyr-project/zephyr/arch/xtensa/Kconfig"
osource "/Users/juliafaubus/zephyr-project/zephyr/arch/sparc/Kconfig"
osource "/Users/juliafaubus/zephyr-project/zephyr/arch/riscv/Kconfig"
osource "/Users/juliafaubus/zephyr-project/zephyr/arch/posix/Kconfig"
osource "/Users/juliafaubus/zephyr-project/zephyr/arch/nios2/Kconfig"
osource "/Users/juliafaubus/zephyr-project/zephyr/arch/mips/Kconfig"
osource "/Users/juliafaubus/zephyr-project/zephyr/arch/arm64/Kconfig"
osource "/Users/juliafaubus/zephyr-project/zephyr/arch/arm/Kconfig"
osource "/Users/juliafaubus/zephyr-project/zephyr/arch/arc/Kconfig"
```

## build/Kconfig/soc/Kconfig
```kconfig
# Load Zephyr SoC Kconfig descriptions.
osource "/Users/juliafaubus/zephyr-project/zephyr/soc/xlnx/zynqmp/Kconfig"
osource "/Users/juliafaubus/zephyr-project/zephyr/soc/xlnx/zynq7000/Kconfig"
osource "/Users/juliafaubus/zephyr-project/zephyr/soc/xen/Kconfig"
osource "/Users/juliafaubus/zephyr-project/zephyr/soc/ti/simplelink/Kconfig"
osource "/Users/juliafaubus/zephyr-project/zephyr/soc/ti/lm3s6965/Kconfig"
osource "/Users/juliafaubus/zephyr-project/zephyr/soc/ti/k3/Kconfig"
osource "/Users/juliafaubus/zephyr-project/zephyr/soc/telink/tlsr/Kconfig"
osource "/Users/juliafaubus/zephyr-project/zephyr/soc/starfive/jh71xx/Kconfig"
osource "/Users/juliafaubus/zephyr-project/zephyr/soc/st/stm32/Kconfig"
osource "/Users/juliafaubus/zephyr-project/zephyr/soc/snps/qemu_arc/Kconfig"
osource "/Users/juliafaubus/zephyr-project/zephyr/soc/snps/nsim/arc_v/Kconfig"
osource "/Users/juliafaubus/zephyr-project/zephyr/soc/snps/nsim/arc_classic/Kconfig"
osource "/Users/juliafaubus/zephyr-project/zephyr/soc/snps/hsdk4xd/Kconfig"
osource "/Users/juliafaubus/zephyr-project/zephyr/soc/snps/hsdk/Kconfig"
osource "/Users/juliafaubus/zephyr-project/zephyr/soc/snps/emsk/Kconfig"
osource "/Users/juliafaubus/zephyr-project/zephyr/soc/snps/emsdp/Kconfig"
osource "/Users/juliafaubus/zephyr-project/zephyr/soc/snps/arc_iot/Kconfig"
osource "/Users/juliafaubus/zephyr-project/zephyr/soc/silabs/Kconfig"
osource "/Users/juliafaubus/zephyr-project/zephyr/soc/sifive/sifive_freedom/Kconfig"
osource "/Users/juliafaubus/zephyr-project/zephyr/soc/rockchip/Kconfig"
osource "/Users/juliafaubus/zephyr-project/zephyr/soc/renode/riscv_virtual/Kconfig"
osource "/Users/juliafaubus/zephyr-project/zephyr/soc/renesas/smartbond/Kconfig"
osource "/Users/juliafaubus/zephyr-project/zephyr/soc/renesas/rzt2m/Kconfig"
osource "/Users/juliafaubus/zephyr-project/zephyr/soc/renesas/rcar/Kconfig"
osource "/Users/juliafaubus/zephyr-project/zephyr/soc/renesas/ra/Kconfig"
osource "/Users/juliafaubus/zephyr-project/zephyr/soc/raspberrypi/Kconfig"
osource "/Users/juliafaubus/zephyr-project/zephyr/soc/quicklogic/eos_s3/Kconfig"
osource "/Users/juliafaubus/zephyr-project/zephyr/soc/qemu/virt_riscv/Kconfig"
osource "/Users/juliafaubus/zephyr-project/zephyr/soc/qemu/malta/Kconfig"
osource "/Users/juliafaubus/zephyr-project/zephyr/soc/openisa/rv32m1/Kconfig"
osource "/Users/juliafaubus/zephyr-project/zephyr/soc/nxp/s32/Kconfig"
osource "/Users/juliafaubus/zephyr-project/zephyr/soc/nxp/rw/Kconfig"
osource "/Users/juliafaubus/zephyr-project/zephyr/soc/nxp/mcx/Kconfig"
osource "/Users/juliafaubus/zephyr-project/zephyr/soc/nxp/lpc/Kconfig"
osource "/Users/juliafaubus/zephyr-project/zephyr/soc/nxp/layerscape/Kconfig"
osource "/Users/juliafaubus/zephyr-project/zephyr/soc/nxp/kinetis/Kconfig"
osource "/Users/juliafaubus/zephyr-project/zephyr/soc/nxp/imxrt/Kconfig"
osource "/Users/juliafaubus/zephyr-project/zephyr/soc/nxp/imx/Kconfig"
osource "/Users/juliafaubus/zephyr-project/zephyr/soc/nuvoton/numicro/Kconfig"
osource "/Users/juliafaubus/zephyr-project/zephyr/soc/nuvoton/numaker/Kconfig"
osource "/Users/juliafaubus/zephyr-project/zephyr/soc/nuvoton/npcx/Kconfig"
osource "/Users/juliafaubus/zephyr-project/zephyr/soc/nordic/Kconfig"
osource "/Users/juliafaubus/zephyr-project/zephyr/soc/neorv32/Kconfig"
osource "/Users/juliafaubus/zephyr-project/zephyr/soc/native/inf_clock/Kconfig"
osource "/Users/juliafaubus/zephyr-project/zephyr/soc/microchip/miv/Kconfig"
osource "/Users/juliafaubus/zephyr-project/zephyr/soc/microchip/mec/Kconfig"
osource "/Users/juliafaubus/zephyr-project/zephyr/soc/mediatek/mtk_adsp/Kconfig"
osource "/Users/juliafaubus/zephyr-project/zephyr/soc/lowrisc/opentitan/Kconfig"
osource "/Users/juliafaubus/zephyr-project/zephyr/soc/litex/litex_vexriscv/Kconfig"
osource "/Users/juliafaubus/zephyr-project/zephyr/soc/ite/ec/Kconfig"
osource "/Users/juliafaubus/zephyr-project/zephyr/soc/intel/raptor_lake/Kconfig"
osource "/Users/juliafaubus/zephyr-project/zephyr/soc/intel/lakemont/Kconfig"
osource "/Users/juliafaubus/zephyr-project/zephyr/soc/intel/intel_socfpga_std/Kconfig"
osource "/Users/juliafaubus/zephyr-project/zephyr/soc/intel/intel_socfpga/Kconfig"
osource "/Users/juliafaubus/zephyr-project/zephyr/soc/intel/intel_niosv/Kconfig"
osource "/Users/juliafaubus/zephyr-project/zephyr/soc/intel/intel_ish/Kconfig"
osource "/Users/juliafaubus/zephyr-project/zephyr/soc/intel/intel_adsp/Kconfig"
osource "/Users/juliafaubus/zephyr-project/zephyr/soc/intel/elkhart_lake/Kconfig"
osource "/Users/juliafaubus/zephyr-project/zephyr/soc/intel/atom/Kconfig"
osource "/Users/juliafaubus/zephyr-project/zephyr/soc/intel/apollo_lake/Kconfig"
osource "/Users/juliafaubus/zephyr-project/zephyr/soc/intel/alder_lake/Kconfig"
osource "/Users/juliafaubus/zephyr-project/zephyr/soc/infineon/cat3/Kconfig"
osource "/Users/juliafaubus/zephyr-project/zephyr/soc/infineon/cat1b/Kconfig"
osource "/Users/juliafaubus/zephyr-project/zephyr/soc/infineon/cat1a/Kconfig"
osource "/Users/juliafaubus/zephyr-project/zephyr/soc/gd/gd32/Kconfig"
osource "/Users/juliafaubus/zephyr-project/zephyr/soc/gaisler/leon3/Kconfig"
osource "/Users/juliafaubus/zephyr-project/zephyr/soc/gaisler/gr716a/Kconfig"
osource "/Users/juliafaubus/zephyr-project/zephyr/soc/espressif/Kconfig"
osource "/Users/juliafaubus/zephyr-project/zephyr/soc/ene/kb1200/Kconfig"
osource "/Users/juliafaubus/zephyr-project/zephyr/soc/efinix/sapphire/Kconfig"
osource "/Users/juliafaubus/zephyr-project/zephyr/soc/cdns/xtensa_sample_controller/Kconfig"
osource "/Users/juliafaubus/zephyr-project/zephyr/soc/cdns/dc233c/Kconfig"
osource "/Users/juliafaubus/zephyr-project/zephyr/soc/brcm/bcmvk/Kconfig"
osource "/Users/juliafaubus/zephyr-project/zephyr/soc/brcm/bcm2712/Kconfig"
osource "/Users/juliafaubus/zephyr-project/zephyr/soc/brcm/bcm2711/Kconfig"
osource "/Users/juliafaubus/zephyr-project/zephyr/soc/atmel/sam0/Kconfig"
osource "/Users/juliafaubus/zephyr-project/zephyr/soc/atmel/sam/Kconfig"
osource "/Users/juliafaubus/zephyr-project/zephyr/soc/aspeed/Kconfig"
osource "/Users/juliafaubus/zephyr-project/zephyr/soc/arm/Kconfig"
osource "/Users/juliafaubus/zephyr-project/zephyr/soc/arm/beetle/Kconfig"
osource "/Users/juliafaubus/zephyr-project/zephyr/soc/andestech/Kconfig"
osource "/Users/juliafaubus/zephyr-project/zephyr/soc/ambiq/Kconfig"
osource "/Users/juliafaubus/zephyr-project/zephyr/soc/altr/zephyr_nios2f/Kconfig"
osource "/Users/juliafaubus/zephyr-project/zephyr/soc/altr/qemu_nios2/Kconfig"
osource "/Users/juliafaubus/zephyr-project/zephyr/soc/adi/max32/Kconfig"
```
